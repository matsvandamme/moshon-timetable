## main/Kconfig.projbuild
```kconfig
menu "Moshon Timetable"

    choice STATION_ACTIVE
        prompt "Active NMBS station"
        default STATION_AALTER
        help
            Which Belgian station's liveboard to show. Pick a preset or
            choose CUSTOM and set STATION_CUSTOM_NAME below.

        config STATION_AALTER
            bool "Aalter"
        config STATION_BRUSSELS_SOUTH
            bool "Brussels-South / Bruxelles-Midi"
        config STATION_BRUSSELS_CENTRAL
            bool "Brussels-Central"
        config STATION_BRUSSELS_NORTH
            bool "Brussels-North"
        config STATION_ANTWERPEN_CENTRAAL
            bool "Antwerpen-Centraal"
        config STATION_GENT_SINT_PIETERS
            bool "Gent-Sint-Pieters"
        config STATION_BRUGGE
            bool "Brugge"
        config STATION_OOSTENDE
            bool "Oostende"
        config STATION_LEUVEN
            bool "Leuven"
        config STATION_LIEGE_GUILLEMINS
            bool "Liege-Guillemins"
        config STATION_NAMUR
            bool "Namur"
        config STATION_CHARLEROI_SUD
            bool "Charleroi-Sud"
        config STATION_CUSTOM
            bool "Custom (set name below)"
    endchoice

    config STATION_CUSTOM_NAME
        string "Custom station name"
        depends on STATION_CUSTOM
        default "Aalter"
        help
            iRail-recognised station name (as returned by the
            https://api.irail.be/stations/ endpoint's `name` field).

    config REFRESH_PERIOD_SECONDS
        int "Refresh period (seconds)"
        range 15 600
        default 45
        help
            How often to re-query the iRail liveboard. iRail asks clients
            to be polite; 30-60 s is reasonable for a passenger display.

    config BOARD_TOGGLE_SECONDS
        int "Departures/Arrivals toggle period (seconds)"
        range 5 60
        default 12
        help
            The display alternates between the Vertrek (departures) and
            Aankomst (arrivals) board, matching the real NMBS station
            display style. This sets how long each side is shown.

    config DEMO_MODE
        bool "Demo mode (synthetic boards, no iRail polling)"
        default n
        help
            When enabled, the device populates the boards with hardcoded,
            realistic-looking trains (with delays, cancellations, accented
            names, etc.) instead of hitting the iRail API. Useful for
            showing the UI off without depending on real overnight
            schedules. Wi-Fi still comes up so the clock can sync.

endmenu
```

## sdkconfig.defaults
```kconfig
# --- Target ---
CONFIG_IDF_TARGET="esp32s3"

# --- Partition table ---
CONFIG_PARTITION_TABLE_CUSTOM=y
CONFIG_PARTITION_TABLE_CUSTOM_FILENAME="partitions.csv"

# --- Flash / PSRAM (WT32-S3-WROVER: 16MB QIO flash + 8MB QUAD PSRAM) ---
# NB: Wireless-Tag's WT32-S3-WROVER uses QSPI PSRAM (not OPI). Setting
# SPIRAM_MODE_OCT here makes the ROM PSRAM probe return 0x00000000 and
# the chip aborts during early boot. Stay on QUAD.
CONFIG_ESPTOOLPY_FLASHSIZE_16MB=y
CONFIG_ESPTOOLPY_FLASHMODE_QIO=y
CONFIG_ESPTOOLPY_FLASHFREQ_80M=y
CONFIG_SPIRAM=y
CONFIG_SPIRAM_MODE_QUAD=y
CONFIG_SPIRAM_SPEED_80M=y
CONFIG_SPIRAM_USE_MALLOC=y
CONFIG_SPIRAM_TRY_ALLOCATE_WIFI_LWIP=y
CONFIG_SPIRAM_MALLOC_ALWAYSINTERNAL=16384
CONFIG_SPIRAM_FETCH_INSTRUCTIONS=y
CONFIG_SPIRAM_RODATA=y

# --- CPU ---
CONFIG_ESP_DEFAULT_CPU_FREQ_MHZ_240=y
CONFIG_FREERTOS_HZ=1000

# --- DHCP-supplied NTP server ---
# Some home routers hand out an NTP server in the DHCP lease (option 42).
# Enabling this lets esp_netif_sntp_init pick it up alongside our
# hardcoded be.pool.ntp.org fallback. Without it, the SNTP init silently
# fails when our code asks for server_from_dhcp = true, the clock stays
# at the 1970 epoch, and every on-screen time is wrong.
CONFIG_LWIP_DHCP_GET_NTP_SRV=y

# --- USB CDC for native USB serial (matches the COM port enumerated on Windows) ---
CONFIG_ESP_CONSOLE_USB_SERIAL_JTAG=y

# --- LWIP / TLS ---
CONFIG_LWIP_TCP_SND_BUF_DEFAULT=16384
CONFIG_LWIP_TCP_RCV_BUF_DEFAULT=16384
CONFIG_MBEDTLS_CERTIFICATE_BUNDLE=y
CONFIG_MBEDTLS_CERTIFICATE_BUNDLE_DEFAULT_FULL=y
CONFIG_MBEDTLS_DYNAMIC_BUFFER=y
CONFIG_ESP_TLS_USING_MBEDTLS=y

# --- HTTP client ---
CONFIG_ESP_HTTP_CLIENT_ENABLE_HTTPS=y

# --- HTTP server (AP-mode captive portal) ---
# Default limits (512 bytes) are too small for modern phones' captive
# portal POST requests: iOS Safari sends a User-Agent + Cookie + Referer
# combination that easily exceeds it, triggering "header fields are too
# long" 431 responses when the user hits Save in the setup form.
CONFIG_HTTPD_MAX_REQ_HDR_LEN=2048
CONFIG_HTTPD_MAX_URI_LEN=1024

# --- Hardware crypto acceleration ---
# Without these the RSA work in the TLS handshake against api.irail.be takes
# several seconds and trips the task watchdog. The ESP32-S3 has hardware MPI
# (big-number) and SHA accelerators; turning them on drops handshake time to
# a few hundred ms.
CONFIG_MBEDTLS_HARDWARE_MPI=y
CONFIG_MBEDTLS_HARDWARE_SHA=y
CONFIG_MBEDTLS_HARDWARE_AES=y

# --- Wi-Fi tuning (small AP / typical home networks) ---
CONFIG_ESP_WIFI_STATIC_RX_BUFFER_NUM=16
CONFIG_ESP_WIFI_DYNAMIC_RX_BUFFER_NUM=32
CONFIG_ESP_WIFI_TX_BUFFER_TYPE=1
CONFIG_ESP_WIFI_DYNAMIC_TX_BUFFER_NUM=32

# --- Logging ---
CONFIG_LOG_DEFAULT_LEVEL_INFO=y
CONFIG_LOG_COLORS=y

# --- Task watchdog: 15s is plenty for any single iRail HTTPS round-trip
# even on a slow uplink. Default 5s spams the console during the handshake.
CONFIG_ESP_TASK_WDT_TIMEOUT_S=15

# --- Main task stack (LVGL + http use a lot) ---
CONFIG_ESP_MAIN_TASK_STACK_SIZE=8192

# --- LCD / RGB color depth: 16bpp for LVGL RGB565 ---
# Do NOT set LV_COLOR_16_SWAP for ST7796 over esp_lcd i80 8-bit; the panel
# I/O layer already serialises bytes in the order the panel wants, and an
# extra swap turns navy into olive/green and yellow into magenta.
CONFIG_LV_COLOR_DEPTH_16=y
# CONFIG_LV_COLOR_16_SWAP is not set

# --- Moshon Timetable defaults (see main/Kconfig.projbuild) ---
CONFIG_STATION_AALTER=y
CONFIG_REFRESH_PERIOD_SECONDS=45
# Production mode by default. Set to =y in your local sdkconfig (or via
# `idf.py menuconfig` -> Moshon Timetable -> Demo mode) for offline UI work
# with synthetic boards instead of live iRail data. NEVER commit =y here.
# CONFIG_DEMO_MODE is not set

# --- LVGL allocator: route via libc malloc -> ESP-IDF heap (incl. PSRAM)
# instead of LVGL's static 64KB TLSF pool. With FULL render mode + the
# embedded NMBS logo asset + all the styles, the small pool overflows
# and TLSF block_absorb loops forever (hangs ui_build()'s styles_init).
CONFIG_LV_USE_BUILTIN_MALLOC=n
CONFIG_LV_USE_CLIB_MALLOC=y

# --- LVGL fonts we use ---
CONFIG_LV_FONT_MONTSERRAT_14=y
CONFIG_LV_FONT_MONTSERRAT_16=y
CONFIG_LV_FONT_MONTSERRAT_20=y
CONFIG_LV_FONT_MONTSERRAT_24=y
CONFIG_LV_FONT_MONTSERRAT_28=y
CONFIG_LV_FONT_MONTSERRAT_36=y

# QR-code widget — used on the splash to render a scannable link to
# the project's GitHub repo. Bundles a small (~10 KB) qrcodegen blob.
CONFIG_LV_USE_QRCODE=y
CONFIG_LV_FONT_DEFAULT_MONTSERRAT_16=y
CONFIG_LV_USE_FLEX=y
CONFIG_LV_USE_GRID=y
CONFIG_LV_USE_LABEL=y
CONFIG_LV_USE_OBSERVER=y
CONFIG_LV_USE_THEME_DEFAULT=y
```
